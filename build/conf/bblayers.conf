## build/conf/bblayers.conf
```bitbake
# POKY_BBLAYERS_CONF_VERSION is increased each time build/conf/bblayers.conf
# changes incompatibly
POKY_BBLAYERS_CONF_VERSION = "2"

BBPATH = "${TOPDIR}"
BBFILES ?= ""

BBLAYERS ?= " \
  /home/sai/rpi/poky/meta \
  /home/sai/rpi/poky/meta-poky \
  /home/sai/rpi/poky/meta-yocto-bsp \
  /home/sai/rpi/meta-openembedded/meta-oe \
  /home/sai/rpi/meta-openembedded/meta-python \
  /home/sai/rpi/meta-openembedded/meta-multimedia \
  /home/sai/rpi/meta-openembedded/meta-networking \
  /home/sai/rpi/meta-raspberrypi \
  /home/sai/rpi/meta-hello \
  "
```

## meta-peripherals/conf/layer.conf
```bitbake
# We have a conf and classes directory, add to BBPATH
BBPATH .= ":${LAYERDIR}"

# We have recipes-* directories, add to BBFILES
BBFILES += "${LAYERDIR}/recipes-*/*/*.bb \
            ${LAYERDIR}/recipes-*/*/*.bbappend"

BBFILE_COLLECTIONS += "meta-peripherals"
BBFILE_PATTERN_meta-peripherals = "^${LAYERDIR}/"
BBFILE_PRIORITY_meta-peripherals = "6"

LAYERDEPENDS_meta-peripherals = "core"
LAYERSERIES_COMPAT_meta-peripherals = "dunfell"
```
